/*  gdpy kernel module: create /dev/gdpymod connected with SPI LED driver
    Copyright (C) 2018  Andrea Simonetto <self@andrea.simonetto.name>

    This program is free software: you can redistribute it and/or modify
    it under the terms of the GNU General Public License as published by
    the Free Software Foundation, either version 3 of the License, or
    (at your option) any later version.

    This program is distributed in the hope that it will be useful,
    but WITHOUT ANY WARRANTY; without even the implied warranty of
    MERCHANTABILITY or FITNESS FOR A PARTICULAR PURPOSE.  See the
    GNU General Public License for more details.

    You should have received a copy of the GNU General Public License
    along with this program.  If not, see <https://www.gnu.org/licenses/>.
*/
#include <linux/init.h>
#include <linux/module.h>
#include <linux/kthread.h>
#include <linux/spi/spi.h>
#include <linux/gpio.h>
#include <linux/spinlock.h>
#include <linux/types.h>
#include <linux/dma-mapping.h>
#include <linux/fcntl.h>
#include <linux/cdev.h>
#include <linux/file.h>
#include <linux/fs.h>
#include <asm/page.h>
#include <linux/delay.h>

MODULE_DESCRIPTION("Driver for 64x64 dot matrix display");
MODULE_AUTHOR("Andrea Simonetto <self@andrea.simonetto.name>");
MODULE_LICENSE("GPL");

#define SCREEN_RESET_GPIO 14
#define SCREEN_RESET_GPIO_NAME "PC23"

static dev_t devnum;
static struct cdev dev;

unsigned char dpybuf[] = { 0x10, 0x10, 0x10, 0x10, 0x10, 0x10, 0x10, 0x10, 0x10, 0x10, 0x10, 0x10, 0x10,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 0x10, 0x10 };
unsigned char dpybuf2[] = { 0x10, 0x10, 0x10, 0x10, 0x10, 0x10, 0x10, 0x10, 0x10, 0x10, 0x10, 0x10, 0x10,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 0x10, 0x10 };

static struct spi_device *spi = 0;
static struct spi_transfer transfer[64];
static struct spi_message message;

void *buf;

static int dev_open(struct inode* inodep, struct file* filep)
{
  printk(KERN_INFO "MWR: Device has been opened\n");
  gpio_direction_input(SCREEN_RESET_GPIO);
  return 0;
}

DEFINE_SEMAPHORE(is_refreshing);

static void refresh_frame_done(void* ctx)
{
  up(&is_refreshing);
}

ssize_t dev_write(struct file *filep, const char __user *data, size_t sz, loff_t *offset)
{
  if(down_trylock(&is_refreshing))
    return 0;

  message.complete = refresh_frame_done;
  memcpy(buf, data, min(sz, (size_t)4096));
  if(spi_async(spi, &message))
    printk("ERROR SENDING\n");
  //else
  //  printk("FRAME\n");

  return sz;
}

int dev_release(struct inode *inode, struct file *filp)
{
  down(&is_refreshing);
  message.complete = refresh_frame_done;
  memset(buf, 0, 4096);
  if(spi_async(spi, &message))
    printk("ERROR SENDING\n");
  // kfree(filp->private_data);
  gpio_direction_output(SCREEN_RESET_GPIO, 0);
  return 0;
}

static struct file_operations fops = {
  .owner =     THIS_MODULE,
  .open = dev_open,
  .write = dev_write,
  .release = dev_release
  //.flush = dev_flush
};

static struct class*  ebbcharClass  = NULL; ///< The device-driver class struct pointer
static struct device* ebbcharDevice = NULL; ///< The device-driver device struct pointer

static int __init gdpymod_init(void)
{
int i, ret;
struct device *device;
dma_addr_t dma;
struct spi_master *master;

  struct spi_board_info spi_device_info = {
    .modalias = "gdpymod",
    .max_speed_hz = 10000000, // Speed the slave can handle
    .bus_num = 2,
    .chip_select = 0,
    .mode = 0
  };

  // Get the spi master
  if(!(master = spi_busnum_to_master(spi_device_info.bus_num))){
    printk(KERN_ALERT "%s: spi bus master (spi%i) not found\n", "myModule", spi_device_info.bus_num);
    return -ENODEV;
  }

  // Create a new slave device, given the master and device info
  spi = spi_new_device(master, &spi_device_info);
  if(!spi) {
    printk(KERN_ALERT "%s: failed to create the %s spi slave\n", "myModule", spi_device_info.modalias);
    return -ENODEV;
  }

  // Set 8Bit mode
  spi->bits_per_word = 8;

  // Setup
  if((ret = spi_setup(spi))){
    printk(KERN_ALERT "%s: failed to setup spi slave\n", "myModule");
    spi_unregister_device(spi);
    return -ENODEV;
  }

  if(gpio_request(SCREEN_RESET_GPIO, SCREEN_RESET_GPIO_NAME)) {
    printk(KERN_ALERT "%s: failed to setup gpio\n", "myModule");
    spi_unregister_device(spi);
    return -ENODEV;
  }

  gpio_direction_output(SCREEN_RESET_GPIO, 0);

  spi_message_init(&message);
  message.context = 0;

  device = &spi->dev;
  device->coherent_dma_mask = 0xffffffff;

  buf = dma_alloc_coherent(device, 4096, &dma, GFP_KERNEL);
  //buf = 0;
  if(buf)
    message.is_dma_mapped = 1;
  else {
    printk("NO DMA! :(\n");
    // And then?
  }

  for(i = 0; i < 64; ++i) {
    if(buf) {
      transfer[i].tx_buf = buf + i * 64;
      transfer[i].tx_dma = dma + i * 64;
    }
    else {
      transfer[i].tx_buf = dpybuf + i * 64;
    }

    transfer[i].len = 64;
    spi_message_add_tail(&transfer[i], &message);
  }

  ret = alloc_chrdev_region(&devnum, 0, 1, "gdpymod");

  // Register character device
  cdev_init(&dev, &fops);

  dev.owner = THIS_MODULE;
  dev.ops = &fops;
  ret = cdev_add(&dev, devnum, 1);

  // Register the device class
  ebbcharClass = class_create(THIS_MODULE, "gdpymod");
  if (IS_ERR(ebbcharClass)){                // Check for error and clean up if there is
     // unregister_chrdev(majorNumber, DEVICE_NAME);
     printk(KERN_ALERT "Failed to register device class\n");
     return PTR_ERR(ebbcharClass);          // Correct way to return an error on a pointer
  }
  printk(KERN_INFO "EBBChar: device class registered correctly\n");

  // Register the device driver
  ebbcharDevice = device_create(ebbcharClass, NULL, devnum, NULL, "gdpymod");
  if (IS_ERR(ebbcharDevice)){               // Clean up if there is an error
     class_destroy(ebbcharClass);           // Repeated code but the alternative is goto statements
     // unregister_chrdev(majorNumber, DEVICE_NAME);
     printk(KERN_ALERT "Failed to create the device\n");
     return PTR_ERR(ebbcharDevice);
  }

  return 0;
}

static void __exit gdpymod_exit(void)
{
  device_destroy(ebbcharClass, devnum);     // remove the device
  class_unregister(ebbcharClass);                          // unregister the device class
  class_destroy(ebbcharClass);
  cdev_del(&dev);
  unregister_chrdev_region(devnum, 1);
  gpio_direction_output(SCREEN_RESET_GPIO, 0);
  gpio_free(SCREEN_RESET_GPIO);
  if(spi)
    spi_unregister_device(spi);
}

module_init(gdpymod_init);
module_exit(gdpymod_exit);
